#include <behaviors.dtsi>
#include <dt-bindings/zmk/keys.h>
#include <dt-bindings/zmk/bt.h>

/ {
    keymap {
        compatible = "zmk,keymap";

        // Define the keymap for the QQ shield
        default_layer {
            bindings = <
                &kp Q
                &kp W
                &kp E
                &kp R
                &kp T
                &kp Y
                &kp U
                &kp I
                &kp O
            >;
        };
    };
};